## package/network/services/openwrt-cups/cups-printer-choose/Config.in
```kconfig
config CUPS_PRINTER_CHOOSE_HP_ZJS
	bool "  HP / Samsung / Konica / Oki ZjStream (foo2zjs)"
	help
		foo2zjs PPD:
		HP LaserJet 1000 / 1005 / P1005 / P1006 / 1018 / 1020 / 1022 /
		1022n / 1022nw / P1505 / M1005 MFP / M1120 MFP / M1319 MFP
		HP Color LaserJet 1500 / 1600 / 2600n / CP1215
		Samsung CLP-2xx / CLP-3xx / CLP-6xx, Konica Minolta magicolor,
		Oki C110 / C130 / C3100 / C5100, Dell 1355 / C1765

config CUPS_PRINTER_CHOOSE_BROTHER
	bool "  Brother DCP/HL/MFC(brlaser)"

config CUPS_PRINTER_CHOOSE_CANON_BJNP
	bool "  Canon BJNP(cups-bjnp)"
```

## target/linux/ath79/files/sound/soc/ath79/Kconfig
```kconfig
# sound/soc/ath79/Kconfig
# SPDX-License-Identifier: GPL-2.0-only

config SND_ATH79_SOC
	tristate "SoC Audio for the Atheros AR9341 (PISEN WMB001N)"
	depends on ATH79
	select SND_SOC_WM8904
	select REGMAP_I2C
	help
	  Say Y to build the AR9341 I2S CPU DAI + WM8918 (WM8904 driver)
	  machine driver into the kernel. Used by the PISEN WMB001N
	  (GPIO11-14 I2S, GPIO16/20 bit-banged I2C codec at 0x1a).
```
